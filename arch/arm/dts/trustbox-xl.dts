/*
 * Copyright 2021 Scalys B.V.
 * opensource@scalys.com
 *
 * SPDX-License-Identifier:	GPL-2.0+
 */

/dts-v1/;
/include/ "fsl-ls1046a.dtsi"

/ {
	model = "TrustBox XL";

	aliases {
		spi0 = &qspi;
	};

};

&qspi {
	bus-num = <0>;
	status = "okay";

	qflash0: mt25qu512abb8esf@0 {
		#address-cells = <1>;
		#size-cells = <1>;
		compatible = "spi-flash";
		spi-max-frequency = <50000000>;
		reg = <0>;
	};

};

