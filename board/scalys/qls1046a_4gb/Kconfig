## board/scalys/qls1046a_4gb/Kconfig
```kconfig
if TARGET_QLS1046A_4GB

config SYS_BOARD
	default "qls1046a_4gb"

config SYS_VENDOR
	default "scalys"

config SYS_SOC
	default "fsl-layerscape"

config SYS_CONFIG_NAME
	default "qls1046a_4gb"
	
config NOR
	bool "Support for NOR flash"
	default y
	
source "board/freescale/common/Kconfig"

endif
```

## board/scalys/trustbox-xl/Kconfig
```kconfig
if TARGET_TRUSTBOX_XL

config SYS_BOARD
	default "trustbox-xl"

config SYS_VENDOR
	default "scalys"

config SYS_SOC
	default "fsl-layerscape"

config SYS_CONFIG_NAME
	default "trustbox-xl"

source "board/freescale/common/Kconfig"
endif
```

## board/scalys/trustbox/Kconfig
```kconfig
if TARGET_TRUSTBOX

config SYS_BOARD
	default "trustbox"

config SYS_VENDOR
	default "scalys"

config SYS_SOC
	default "fsl-layerscape"

config SYS_CONFIG_NAME
	default "trustbox"

config SYS_LS_PPA_FW_ADDR
        hex "PPA Firmware Addr"
        default 0x40280000

config PBL_RCW_SECUREBOOT
	bool
	default n
	prompt "Enable Reset Control Word based secure boot for development"
	help
		To enable secure boot OTPMK and SRKH must be fused, u-boot-spl.bin must be signed, and the CSF header must be written to SPI flash.
		While using RCW secure boot a hash or signature failure while loading ESBC will not cause a boot halt, but SSM state will be non-secure.
		The Intent To Secure fuse should be blown for production platforms.

if CHAIN_OF_TRUST
config SYS_LS_PPA_ESBC_ADDR
	hex "PPA Firmware HDR Addr"
	default 0x403c0000
endif

menu "PFE configuration options"
	depends on FSL_PFE

config SYS_LS_PFE_ESBC_ADDR
	hex "PFE Firmware HDR Addr"
	default 0x40700000

config DDR_PFE_PHYS_BASEADDR
	hex "PFE DDR physical base address"
	default 0x03800000

config DDR_PFE_BASEADDR
	hex "PFE DDR base address"
	default 0x83800000

config SYS_LS_PFE_FW_ADDR
	hex "Flash address of PFE firmware"
	default 0x40240000

config PFE_EMAC1_PHY_ADDR
	hex "EMAC1 phy address"
	default 0x2

config PFE_EMAC2_PHY_ADDR
	hex "EMAC2 phy address"
	default 0x1

endmenu

source "board/freescale/common/Kconfig"

endif
```

## configs/trustbox_qspi_secureboot_defconfig
```kconfig
CONFIG_ARM=y
CONFIG_TARGET_TRUSTBOX=y
CONFIG_SYS_TEXT_BASE=0x82000000
CONFIG_QSPI_AHB_INIT=y
CONFIG_DEFAULT_DEVICE_TREE="trustbox"
CONFIG_SYS_LS_PPA_FW_ADDR=0x40280000
CONFIG_NR_DRAM_BANKS=2
CONFIG_PBL_RCW_SECUREBOOT=y

# SPL
CONFIG_SPL=y
CONFIG_FSL_LS_PPA=y
CONFIG_SPL_FSL_LS_PPA=y
CONFIG_ARMV8_SEC_FIRMWARE_SUPPORT=y
CONFIG_SPL_RAM_SUPPORT=y
CONFIG_SPL_RAM_DEVICE=y
CONFIG_SPL_OF_LIBFDT=y
CONFIG_SPL_LOAD_FIT=y
CONFIG_OF_LIST="trustbox"
CONFIG_SPL_FIT=y
CONFIG_FIT=y
CONFIG_SPL_SERIAL_SUPPORT=y
CONFIG_USE_TINY_PRINTF=y
CONFIG_SPL_LIBCOMMON_SUPPORT=y
CONFIG_SPL_LIBGENERIC_SUPPORT=y
CONFIG_SPL_MPC8XXX_INIT_DDR_SUPPORT=y
CONFIG_SPL_BOARD_INIT=y
CONFIG_SPL_DRIVERS_MISC_SUPPORT=y
CONFIG_SPL_STACK_R=y
CONFIG_SPL_STACK_R_ADDR=0x90000000
CONFIG_SPL_FIT_IMAGE_TINY=y
CONFIG_SPL_DM=y
CONFIG_FSL_SEC_MON=y
CONFIG_SPL_RSA=y
CONFIG_SPL_HASH_SUPPORT=y

# SPL device identity
CONFIG_FSL_CAAM=y
CONFIG_SPL_CRYPTO_SUPPORT=y
CONFIG_CMD_BLOB=y
CONFIG_CMD_DEKBLOB=y

CONFIG_CYRES=y
CONFIG_CYRES_CERT_CHAIN_ADDR=0x81FFD000
CONFIG_CYRES_CERT_CHAIN_SIZE=0x3000
CONFIG_CYRES_CERT_CHAIN_PATH_LENGTH=4
CONFIG_CYRES_KEY_BLOB_ADDR=0x81FFC000
CONFIG_CYRES_KEY_BLOB_SIZE=0x1000

CONFIG_AHCI=y
CONFIG_DISTRO_DEFAULTS=y
CONFIG_PFE_EMAC1_PHY_ADDR=0x1
CONFIG_PFE_EMAC2_PHY_ADDR=0x2
CONFIG_PHY_TI=y
# CONFIG_SYS_MALLOC_F is not set
CONFIG_FIT_VERBOSE=y
CONFIG_OF_BOARD_SETUP=y
CONFIG_OF_STDOUT_VIA_ALIAS=y
CONFIG_SYS_EXTRA_OPTIONS="QSPI_BOOT"
CONFIG_QSPI_BOOT=y
CONFIG_BOOTDELAY=-2
CONFIG_USE_BOOTARGS=y
CONFIG_BOOTARGS="console=ttyS0,115200 earlycon=uart8250,mmio,0x21c0500 lpj=250000 loglevel=2 noinitrd root=/dev/mmcblk0p1 rootfstype=ext4 rw rootwait"
CONFIG_USE_BOOTCOMMAND=y
# CONFIG_DISPLAY_BOARDINFO is not set
CONFIG_DISPLAY_BOARDINFO_LATE=y
CONFIG_CMD_MEMTEST=y
CONFIG_CMD_GPT=y
CONFIG_CMD_I2C=y
CONFIG_CMD_MMC=y
CONFIG_CMD_PCI=y
CONFIG_CMD_SF=y
CONFIG_CMD_USB=y
# CONFIG_CMD_SETEXPR is not set
CONFIG_CMD_CACHE=y
CONFIG_OF_CONTROL=y
CONFIG_ENV_IS_NOWHERE=y
CONFIG_NET_RANDOM_ETHADDR=y
CONFIG_DM=y
CONFIG_SATA_CEVA=y
CONFIG_DM_MMC=y
CONFIG_FSL_ESDHC=y
CONFIG_DM_SPI_FLASH=y
CONFIG_SPI_FLASH=y
# CONFIG_SPI_FLASH_USE_4K_SECTORS is not set
CONFIG_FSL_PFE=y
CONFIG_PHYLIB=y
CONFIG_DM_ETH=y
CONFIG_E1000=y
CONFIG_PCI=y
CONFIG_DM_PCI=y
CONFIG_DM_PCI_COMPAT=y
CONFIG_PCIE_LAYERSCAPE=y
CONFIG_SCSI=y
CONFIG_SCSI_AHCI=y
CONFIG_DM_SCSI=y
CONFIG_SYS_NS16550=y
CONFIG_SPI=y
CONFIG_DM_SPI=y
CONFIG_FSL_DSPI=y
CONFIG_USB=y
CONFIG_DM_USB=y
CONFIG_USB_XHCI_HCD=y
CONFIG_USB_XHCI_DWC3=y
CONFIG_USB_STORAGE=y

# Secure boot
CONFIG_SECURE_BOOT=y
CONFIG_CHAIN_OF_TRUST=y
CONFIG_CMD_ESBC_VALIDATE=y
CONFIG_SYS_LS_PFE_ESBC_ADDR=0x40400000
CONFIG_SYS_LS_PPA_ESBC_ADDR=0x40440000
CONFIG_RSA=y
CONFIG_RSA_SOFTWARE_EXP=y
CONFIG_RSA_FREESCALE_EXP=y
CONFIG_SHA_PROG_HW_ACCEL=y
```
